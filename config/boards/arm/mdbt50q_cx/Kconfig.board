## config/boards/arm/mdbt50q_cx/Kconfig.board
```kconfig
# MDBT50Q-CX board configuration

# Copyright (c) 2020 The ZMK Contributors
# SPDX-License-Identifier: MIT

config BOARD_MDBT50Q_CX
	bool "MDBT50Q-CX nRF52840 Dongle"
	depends on SOC_NRF52840_QIAA
```

## config/boards/arm/mdbt50q_cx/mdbt50q_cx_defconfig
```kconfig
# SPDX-License-Identifier: MIT

CONFIG_SOC_SERIES_NRF52X=y
CONFIG_SOC_NRF52840_QIAA=y
CONFIG_BOARD_MDBT50Q_CX=y

# Enable MPU
CONFIG_ARM_MPU=y

# Enable RTT
CONFIG_USE_SEGGER_RTT=y

# Enable GPIO
CONFIG_GPIO=y

# Enable uart driver
CONFIG_SERIAL=y

# Enable console
CONFIG_CONSOLE=y
CONFIG_UART_CONSOLE=y

# Additional board options
CONFIG_BT_CTLR_TX_PWR_PLUS_8=y

# Enable USB CDC ACM
CONFIG_USB_DEVICE_STACK=y
CONFIG_USB_CDC_ACM=y
```
